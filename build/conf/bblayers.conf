## build/conf/bblayers.conf
```bitbake
# LAYER_CONF_VERSION is increased each time build/conf/bblayers.conf
# changes incompatibly
LCONF_VERSION = "6"

BBPATH = "${TOPDIR}"
BBFILES ?= ""

BBLAYERS ?= " \
  /home/dguthrie/workspace/zedboard-yocto.git/meta \
  /home/dguthrie/workspace/zedboard-yocto.git/meta-yocto \
  /home/dguthrie/workspace/zedboard-yocto.git/meta-xilinx \
  "
BBLAYERS_NON_REMOVABLE ?= " \
  /home/dguthrie/workspace/zedboard-yocto.git/meta \
  /home/dguthrie/workspace/zedboard-yocto.git/meta-yocto \
  "
```
